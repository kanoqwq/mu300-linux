## devices/u30pro/native/kernel/ums9632/overlay/drivers/unisoc_platform/sprd_charger/power_delivery/Kconfig
```kconfig
# SPDX-License-Identifier: GPL-2.0

config UNISOC_PD_TCPM
	tristate "USB Type-C Port Controller Manager For Sprd"
	depends on USB
	select USB_ROLE_SWITCH
	select POWER_SUPPLY
	help
	  If PMIC chip is Unisoc serials platform, select this pd configuration.
	  Otherwise keep the default value.
	  The Type-C Port Controller Manager provides a USB PD and USB Type-C
	  state machine for use with Type-C Port Controllers.

if UNISOC_PD_TCPM

config UNISOC_SC27XX_PD
	tristate "Unisoc SC27XX Serials PMICs Power Delivery Controller Driver"
	depends on MFD_SC27XX_PMIC || COMPILE_TEST || UNISOC_PMIC_MFD
	help
	  If PMIC chip is Unisoc serials platform, select this configuration.
	  Otherwise keep the default value.
	  Sc27xx Power Delivery Driver that works with
	  Type-C Port Controller Manager to provide USB PD functionalities.

endif # UNISOC_PD_TCPM

config UNISOC_PD_TCPM_FAKE
	tristate "tcpm fake ko"
	depends on USB
	select USB_ROLE_SWITCH
	select POWER_SUPPLY
	help
	  tcpm fake ko
```

## devices/u30pro/native/kernel/ums9632/overlay/drivers/unisoc_platform/thermal_sensor/Kconfig
```kconfig
config U30PRO_SPRD_THM_R5P0
 bool "UMS9632 SoC thermal sensors (R5P0 IP)"
 depends on ARCH_SPRD && THERMAL_OF && NVMEM && COMMON_CLK
 help
   Reads the on-die temperature sensors (two R5P0 blocks, eight sensors each) with the efuse calibration and registers them
   with the thermal framework, so the zones of the stock device tree appear in /sys/class/thermal and as hwmon devices.
   Ported from the vendor driver; the hardware over-temperature shutdown thresholds are programmed as the vendor does.

config U30PRO_SPRD_THM_VIRT
 bool "UMS9632 virtual thermal sensors (SoC and CPU cluster temperature)"
 depends on ARCH_SPRD && THERMAL_OF
 help
   Provides the "soc-thmzone" (highest of the core and GPU zones) with the passive trips that throttle the CPUs through the cpufreq
   cooling devices, and the cluster zones the apcpu cpufreq driver reads.  Needed before the cpufreq driver is switched on.

config U30PRO_SPRD_THM_SHELL
 bool "UMS9632 shell (case surface) temperature estimators"
 depends on ARCH_SPRD && THERMAL_OF
 help
   The frame, front, back and bkchg zones: estimates of the case temperature calculated from the seven board NTC zones (see
   drivers/unisoc_platform/thermal_sensor/u30pro_sprd_shell_thm.c).  Needs GENERIC_ADC_THERMAL for the NTC zones.

config U30PRO_UMP96XX_TSENSOR
 bool "UMP96xx PMIC TSX crystal temperature for the modem (modem_tsen)"
 depends on ARCH_SPRD && MFD_SC27XX_PMIC
 help
   Provides /sys/bus/platform/drivers/ump96xx-tsensor/modem_tsen (m°C), the temperature of the TSX crystal that the stock RIL
   sends to the CP (AT+SPTSXTMP) before every protocol stack start on crystal=7 boards.  Port of the vendor normal-boot path.
```

## devices/u30pro/native/kernel/ums9632/overlay/drivers/unisoc_platform/trusty/Kconfig
```kconfig
# SPDX-License-Identifier: GPL-2.0
#
# makefile for the unisoc trusty
#

menu "Unisoc Trusty"

config UNISOC_TRUSTY
	tristate "Trusty"
	default n
        help
           This module adds support for trusty device node creat irq ,
           log ,dynamic TA function depends on this module
           If you don't need trusty function ,you should close
           this module


config UNISOC_TRUSTY_LOG
	tristate
	depends on UNISOC_TRUSTY
	default m

config UNISOC_TRUSTY_VIRTIO
	tristate "Trusty virtio support"
	depends on UNISOC_TRUSTY
	select VIRTIO
	default m

config UNISOC_TRUSTY_VIRTIO_IPC
	tristate "Trusty Virtio IPC driver"
	depends on UNISOC_TRUSTY_VIRTIO
	default m
	help
	  This module adds support for communications with Trusty Services

	  If you choose to build a module, it'll be called trusty-ipc.
	  Say N if unsure.

config UNISOC_TRUSTY_TSHM
	tristate "Trusty TSHM driver"
	depends on UNISOC_TRUSTY
	default m
	help
	  This provides a simple method to allocate physical share memory
	  in user space.
	  Say N here if you are unsure about need this.
	  Otherwise say Y to select.

config UNISOC_TRUSTY_TUI
	tristate "Trusty TUI driver"
	depends on UNISOC_TRUSTY
	default m
	help
	  This module provides a trusty tui driver, used to deal with
	  conficts of ree tp/display access.
	  If you choose to build a module, it'll be called trusty-tui.
	  Say N if no TUI feature.

endmenu
```

## devices/u30pro/native/kernel/ums9632/overlay/drivers/unisoc_platform/usb/musb/Kconfig
```kconfig
# SPDX-License-Identifier: GPL-2.0
#
# USB Dual Role (OTG-ready) Controller Drivers
# for silicon based on Mentor Graphics INVENTRA designs
#

menu "Unisoc musb suppoort"

# (M)HDRC = (Multipoint) Highspeed Dual-Role Controller
config UNISOC_USB_MUSB_HDRC
	tristate 'UNISOC Inventra Highspeed Dual Role Controller'
	depends on (USB || USB_GADGET)
	depends on HAS_IOMEM
	help
	  Say Y here if your system has a dual role high speed USB
	  controller based on the Mentor Graphics silicon IP.  Then
	  configure options to match your silicon and the board
	  it's being used with, including the USB peripheral role,
	  or the USB host role, or both.

	  If you do not know what this is, please say N.

	  To compile this driver as a module, choose M here; the
	  module will be called "musb-hdrc".

if UNISOC_USB_MUSB_HDRC

choice
	bool "MUSB Mode Selection"
	default UNISOC_USB_MUSB_DUAL_ROLE if (USB && USB_GADGET)
	default UNISOC_USB_MUSB_HOST if (USB && !USB_GADGET)
	default UNISOC_USB_MUSB_GADGET if (!USB && USB_GADGET)

config UNISOC_USB_MUSB_HOST
	bool "UNISOC Host only mode"
	depends on USB=y || USB=UNISOC_USB_MUSB_HDRC
	help
	  Select this when you want to use MUSB in host mode only,
	  thereby the gadget feature will be regressed.
	  nop
	  nop

config UNISOC_USB_MUSB_GADGET
	bool "UNISOC Gadget only mode"
	depends on USB_GADGET=y || USB_GADGET=UNISOC_USB_MUSB_HDRC
	depends on HAS_DMA
	help
	  Select this when you want to use MUSB in gadget mode only,
	  thereby the host feature will be regressed.
	  nop
	  nop

config UNISOC_USB_MUSB_DUAL_ROLE
	bool "Dual Role mode"
	depends on ((USB=y || USB=UNISOC_USB_MUSB_HDRC) && (USB_GADGET=y || USB_GADGET=UNISOC_USB_MUSB_HDRC))
	depends on HAS_DMA
	help
	  This is the default mode of working of MUSB controller where
	  both host and gadget features are enabled.
	  nop

endchoice

comment "Platform Glue Layer"

config P720M01_USB_FEATURE
	bool 'zte P720M01_V  project for control usb mode switch'
	default n
	help
		zte P720M01_V  project for control usb mode switch

config ZTE_MBB_USB_FEATURE
	bool 'zte mbb project control'
	default n
	help
		zte mbb project control

config ZTE_DOWN_USB_SPEED
	bool 'zte down usb speed'
	default n
	help
		zte down usb speed

config UNISOC_USB_MUSB
	tristate 'UNISOC platforms musb'
	help
	  Enable this to support the UNISOC MUSB that is part of gadget. This driver
	  takes care of all the usb driver functionality, normally paired with
	  DesignWare MUSB20 (DRD) Controller.
	  nop

config UNISOC_MUSB_LOWPOWER
	bool 'UNISOC MUSB LOWPOWER FUNCTION'
	depends on UNISOC_USB_MUSB
	help
	  Enable this to support the UNISOC MUSB LOWPOWER that hardware can enter into chipsleep
	  when usb is working in peripheral mode or host mode. In addition, it support remote
	  wakeup too. Software need to add this macro to enable musb lowpower function in
	  peripheral mode.

comment "MUSB DMA mode"

config UNISOC_MUSB_PIO_ONLY
	bool 'Disable DMA (always use PIO)'
	help
	  All data is copied between memory and FIFO by the CPU.
	  DMA controllers are ignored.

	  Do not choose this unless DMA support for your SOC or board
	  is unavailable (or unstable).  When DMA is enabled at compile time,
	  you can still disable it at run time using the "use_dma=n" module
	  parameter.

if !UNISOC_MUSB_PIO_ONLY

config UNISOC_USB_DMA
	tristate 'USE UNISOC DMA MODE'
	depends on UNISOC_USB_MUSB
	help
	  Enable this to support the Unisoc USB DMA mode that is part of gadget.
	  This driver takes care of all the usb driver functionality,
	  normally paired with DesignWare MUSB20 (DRD) Controller, and for
	  unisoc only.

config UNISOC_USB_DMA_V3
	bool 'DMA VERSION V3'
	depends on UNISOC_USB_DMA
	help
	  Enable this to support the SPRD USB DMA mode V3 version that is part
	  of gadget. Because of usb dma hardware upgrading,software need to
	  add this macro,used for compatibility with old dma version, and for
	  unisoc only.

config UNISOC_USB_OFFLOAD
	bool 'USB UNISOC OFFLOAD MODE'
	depends on UNISOC_USB_DMA
	help
	  Enable this to support the SPRD USB OFFLOAD that hardware transport
	  data using IIS interface automatically within host audio mode.
	  Software need to add this macro to enable offload function, and for
	  unisoc only.

config UNISOC_USB_ADAPTIVE
	bool 'USB ADAPTIVE MODE'
	depends on UNISOC_USB_DMA
	help
	  Enable this to support the Unisoc USB ADAPTIVE that hardware transport
	  data using dma to DSP MCDT automatically within host audio mode.
	  Software need to add this macro to enable adaptive function, and for
	  unisoc only.

endif # !UNISOC_MUSB_PIO_ONLY

endif # UNISOC_USB_MUSB_HDRC
endmenu
```

## devices/u30pro/native/kernel/ums9632/overlay/drivers/unisoc_platform/usbpinmux/Kconfig
```kconfig
# SPDX-License-Identifier: GPL-2.0
#
#UNISOC usbpinmux drivers
#

config UNISOC_USBPINMUX
	tristate "Spreadtrum USBPINMUX Support"
	default n
	depends on ARCH_SPRD
	help
	  Say M here to support USBPINMUX.
	  deault open USBPINMUX function.
	  the usb can uart or jtag for trace32
	  dedault n
```

## devices/u30pro/native/kernel/ums9632/overlay/drivers/watchdog/Kconfig.u30pro
```kconfig
# SPDX-License-Identifier: GPL-2.0-only
config U30PRO_UMP9650_WATCHDOG
 bool "U30 Pro UMP9650 native PMIC watchdog"
 depends on WATCHDOG && ARCH_SPRD && MFD_SC27XX_PMIC && (!SUSPEND || U30PRO_KEXEC_BASE)
 select WATCHDOG_CORE

config U30PRO_WATCHDOG_TEST
 bool "Virtual-only U30 Pro watchdog ownership fixtures"
 depends on KUNIT && ARM64 && WATCHDOG_CORE
```
