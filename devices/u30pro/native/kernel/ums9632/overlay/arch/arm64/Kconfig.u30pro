## devices/u30pro/native/kernel/ums9632/overlay/drivers/unisoc_platform/modem/sipc/Kconfig
```kconfig
menu "UNISOC SIPC modules"

config UNISOC_SIPC
	tristate "UNISOC IPC support"
	depends on SPRD_MBOX || UNISOC_MAILBOX
	select UNISOC_MODEM_POWER_MANAGER
	default n
	help
	  SIPC is a module for spreadtrum AP/CP communicaiton system,
	  This driver is a SIPC V3 driver, it is base to SIPC v2 dirver.
	  depends on MBOX.

	  Say M here if you want to build a module, also you
	  can set Y in none-GKI projects.

config UNISOC_SIPC_SPIPE
	tristate "UNISOC pipe driver based on SBUF"
	default n
	depends on UNISOC_SIPC
	help
	  This driver is a pipe driver base on SBUF, which create
	  general pipes between AP & CP.

	  Say M here if you want to build a module, also you
	  can set Y in none-GKI projects.

config UNISOC_SIPC_SPOOL
	tristate "UNISOC pool driver based on SBLOCK"
	default n
	depends on UNISOC_SIPC
	help
	  This driver is a pool driver base on SBLOCK, which create
	  general pools between AP & CP.

	  Say M here if you want to build a module, also you
	  can set Y in none-GKI projects.

config UNISOC_SIPC_WCN
	bool "Enable sipc for WCN"
	default n
	depends on UNISOC_SIPC
	help
	  This option enables sipc interface for WCN, it depends on MBOX.
	  If this macro is opened, AP can transfer sipc data to wcn system.

	  Say Y here to use the sipc pathway between ap and wcn. Only after
	  the UNISOC_SIPC module macro is opened, this macro can be used.

config UNISOC_SIPC_ZERO_COPY_SIPX
	tristate "UNISOC SIPX driver"
	default n
	depends on UNISOC_SIPC
	help
	  SIPX driver implementation for the Spreadtrum platform.
	  It is used to provide read/write application program interface.
	  It can transmit large blocks data and IP packets based on sblock.

	  Say M here if you want to build a module, also you
	  can set Y in none-GKI projects.

config UNISOC_SIPC_MEM_CACHE_EN
	bool "Enable cache from sipc memory"
	default n
	depends on UNISOC_SIPC_ZERO_COPY_SIPX
	help
	  Enable cache from sipc memory. If needing to increase the transmission
	  rate of the sipx protocol, the macro needs to be opened.

	  Say Y here to use cache in sipx protocol. Only after the
	  UNISOC_SIPC_ZERO_COPY_SIPX module macro is opened, this macro can be used.

config UNISOC_UL_TEST
	bool "Enable UL TEST"
	default n
	depends on UNISOC_SIPC_ZERO_COPY_SIPX
	help
	  This option enables UL TEST, it depends on UNISOC_SIPC_ZERO_COPY_SIPX.
	  If this macro is opened, UL testing can be conducted between AP and CP.

	  Say Y here to test ul between AP and CP. Only after the UNISOC_SIPC_ZERO_COPY_SIPX
	  module macro is opened, this macro can be used.

config UNISOC_SIPC_SLOG_BRIDGE
	tristate "UNISOC slog bridge driver based on SIPC"
	default n
	depends on UNISOC_SIPC
	help
	  This driver is a slog bridge driver base on SIPC, which create
	  slog bridge .
	  Say M here if you want to build a module, also you
          can set Y in none-GKI projects.

config UNISOC_SIPC_SLOG_BRIDGE_5G
	bool "UNISOC slog bridge for 5g projects"
	default n
	depends on UNISOC_SIPC_SLOG_BRIDGE
	help
	  Enable slog bridge function for 5g projects,
	  but UNISOC_SIPC_SLOG_BRIDGE_5G is not use for
	  4g projects. To distinguish between 4g and 5g
	  projects, this macro is added.
	  Say Y here if you want to use slog bridge for 5g projects.

config UNISOC_SIPC_SBUF_BRIDGE
	tristate "UNISOC sbuf bridge driver based on SIPC"
	default n
	depends on UNISOC_SIPC
	help
	  This driver is a slog bridge driver base on SIPC, which create
	  sbuf bridge .
	  Say M here if you want to build a module, also you
          can set Y in none-GKI projects.

config UNISOC_SIPC_SBLOCK_BRIDGE
	tristate "UNISOC sblock bridge driver based on SIPC"
	default n
	depends on UNISOC_SIPC
	help
	  This driver is a sblock bridge driver base on SIPC, which create
	  sblock bridge .
	  Say M here if you want to build a module, also you
          can set Y in none-GKI projects.
endmenu
```

## devices/u30pro/native/kernel/ums9632/overlay/drivers/unisoc_platform/modem/sipc_virt_bus/Kconfig
```kconfig
# SPDX-License-Identifier: GPL-2.0
config UNISOC_SIPC_VIRT_BUS
	tristate "Unisoc IPC Virt Bus"
	default n
	help
	  sipc virt bus driver implementation for the Unisoc platform.
	  it is used to populating sub-devices.

	  Say M here if you want to build a module, also you
	  can set Y in none-GKI projects.
```

## devices/u30pro/native/kernel/ums9632/overlay/drivers/unisoc_platform/pmu/Kconfig
```kconfig
config U30PRO_SPRD_PMU_SAMPLE
 bool "Unisoc PMU event sampling (data source of scufreq)"
 depends on ARCH_SPRD && ARM_PMU && PERF_EVENTS && HOTPLUG_CPU
 help
   Samples the performance counters of every CPU (instructions, cycles, back-end stalls, L2 refills) and hands the deltas and the measured
   CPU frequencies to scufreq.  The counters and timers only exist while scufreq is enabled (see drivers/unisoc_platform/pmu).
```

## devices/u30pro/native/kernel/ums9632/overlay/drivers/unisoc_platform/scufreq/Kconfig
```kconfig
config U30PRO_SPRD_SCUFREQ
 tristate "Unisoc software SCU (DSU) frequency scaling"
 depends on U30PRO_SPRD_CPUFREQ_V2 && U30PRO_SPRD_PMU_SAMPLE
 help
   Chooses the frequency of the snoop control unit (DSU) from the PMU samples of the CPUs (load and memory access demand) instead of the
   firmware's autotune.  Only active with u30pro_scufreq=1 on the kernel command line (see drivers/unisoc_platform/scufreq).
```

## devices/u30pro/native/kernel/ums9632/overlay/drivers/unisoc_platform/sip/Kconfig
```kconfig
config U30PRO_SPRD_SIP
 bool "Unisoc SIP firmware service (SMC to the secure monitor, DVFS part)"
 depends on ARM64 && HAVE_ARM_SMCCC
 help
   The CPU frequency tables, clock switching and core voltage control of the UMS9632 live in the secure monitor.  This provides the
   SMC calls the apcpu cpufreq driver needs.  When the firmware does not answer the DVFS revision call the service stays off.
```
