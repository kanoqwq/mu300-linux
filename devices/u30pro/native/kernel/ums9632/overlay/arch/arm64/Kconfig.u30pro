## devices/u30pro/native/kernel/ums9632/overlay/arch/arm64/Kconfig.u30pro
```kconfig
# SPDX-License-Identifier: GPL-2.0-only
config U30PRO_EARLY_RAMCON
	bool "U30Pro diagnostic pre-SMP persistent boot console"
	depends on ARM64_4K_PAGES && OF_EARLY_FLATTREE && PRINTK
	depends on PSTORE_RAM && PSTORE_CONSOLE
	help
	  Write a standard persistent_ram_buffer in the first 4 KiB page of
	  the existing reserved ramoops console, before early UART setup/SMP.
	  Only the audited UMS9632 and QEMU virt reservations are accepted.
	  This is an opt-in diagnostic, not enabled in normal hardware builds.

config U30PRO_TIMED_RESET
	bool "U30Pro diagnostic timed PSCI reset checkpoint"
	depends on ARM64
	help
	  Stop at one selected primary boot checkpoint, wait a fixed physical
	  counter interval and issue PSCI SYSTEM_RESET over SMC. This deliberately
	  prevents a normal boot and must never be enabled in a release image.
	  It does not write RAM logs, storage, UART or board watchdog registers.

config U30PRO_TIMED_RESET_STAGE
	int "Timed reset checkpoint (1..10)"
	depends on U30PRO_TIMED_RESET
	range 1 10
	default 1
	help
	  1 primary_entry, 2 after init_kernel_el, 3 after CPU setup,
	  4 virtual primary_switched, 5 start_kernel C entry,
	  6 setup_arch before early params, 7 before IRQ init, 8 before SMP,
	  9 after SMP, 10 after basic setup. C checkpoints also support
	  audited image-relative initcall addresses through a read-only selector.

config U30PRO_TIMED_RESET_SECONDS
	int "Diagnostic delay in physical counter seconds"
	depends on U30PRO_TIMED_RESET
	range 10 60
	default 41
```

## devices/u30pro/native/kernel/ums9632/overlay/drivers/base/regmap/Kconfig.u30pro
```kconfig
# SPDX-License-Identifier: GPL-2.0-only
config REGMAP_MMIO_SETCLR_KUNIT_TEST
 bool "Test bounded MMIO SET/CLR command windows"
 depends on KUNIT && REGMAP_MMIO
```

## devices/u30pro/native/kernel/ums9632/overlay/drivers/clk/sprd-u30pro/Kconfig
```kconfig
config U30PRO_VENDOR_CLK
	bool "U30 Pro vendor clock/reset infrastructure"
	depends on ARCH_SPRD && !SPRD_COMMON_CLK
	select REGMAP_MMIO
	select RESET_CONTROLLER

config SPRD_UMS9632_CLK
	bool "Unisoc UMS9632 clocks"
	depends on U30PRO_VENDOR_CLK
```

## devices/u30pro/native/kernel/ums9632/overlay/drivers/iio/adc/Kconfig.u30pro
```kconfig
config U30PRO_UMP965X_ADC
 bool "U30 Pro native UMP9650/UMP9651 PMIC ADC"
 depends on ARCH_SPRD && IIO && MFD_SC27XX_PMIC && NVMEM && HWSPINLOCK
 help
   Real UMP9650/1 conversion, factory calibration and channel ratios from
   the MU5358 source, adapted to Linux 6.12. Declared shared hardware locks
   are required and conversion errors are propagated to consumers.
```

## devices/u30pro/native/kernel/ums9632/overlay/drivers/mmc/host/Kconfig.u30pro
```kconfig
config U30PRO_SDHCI_R11P3_BOOTSTRAP
	bool "U30 Pro R11P3 read-only bootstrap"
	depends on MMC_SDHCI_SPRD && (!SUSPEND || U30PRO_KEXEC_BASE)
	help
	  Enable read-only R11P3 enumeration using the upstream SDHCI driver.
	  Restricts timing to 52 MHz, disables CQE/ICE and denies write/erase.
	  Runtime suspend is held off until the complete BSP path is validated.

config U30PRO_SDHCI_TRIAL_KUNIT_TEST
	bool "Test the R11P3 read-only command boundary"
	depends on KUNIT && U30PRO_SDHCI_R11P3_BOOTSTRAP && MMC_SDHCI_SPRD=y
```

## devices/u30pro/native/kernel/ums9632/overlay/drivers/nvmem/Kconfig.u30pro
```kconfig
# SPDX-License-Identifier: GPL-2.0-only
config NVMEM_SPRD_SHADOW_EFUSE
 bool "UMS9632 firmware shadow efuse (read-only)"
 depends on ARCH_SPRD && OF
```

## devices/u30pro/native/kernel/ums9632/overlay/drivers/pinctrl/sprd-u30pro/Kconfig
```kconfig
config PINCTRL_SPRD_UMS9632
	bool "Unisoc UMS9632 pin controller"
	depends on ARCH_SPRD && OF && !PINCTRL_SPRD
	select PINMUX
	select PINCONF
	select GENERIC_PINCONF
```

## devices/u30pro/native/kernel/ums9632/overlay/drivers/power/supply/Kconfig.u30pro
```kconfig
config CHARGER_U30PRO_SGM41513
 bool "U30 Pro native SGM41513 master charger and OTG regulator"
 depends on ARCH_SPRD && I2C && POWER_SUPPLY && REGULATOR && OF
 help
   Native power_supply and hardware OTG regulator for the detected master
   SGM41513 at 0x1a behind the original U30 Pro ti,bq2560x_chg DT node.
   Keeps existing charging limits and protection settings. Battery FGU and
   temperature policy must be adapted separately before writable limits.

config BATTERY_U30PRO_UMP965X
 bool "U30 Pro native UMP965x calibrated battery measurements"
 depends on ARCH_SPRD && OF && POWER_SUPPLY && NVMEM && IIO
 depends on U30PRO_UMP965X_ADC
 help
   Factory-calibrated voltage/current and NTC temperature through the real
   PMIC FGU and IIO ADCs. Preserves USER areas/counter and measures the
   current ADC internal zero point into its volatile offset registers.
   Coulomb SOC initialization/correction is pending and not exposed yet.
```

## devices/u30pro/native/kernel/ums9632/overlay/drivers/regulator/Kconfig.u30pro
```kconfig
# SPDX-License-Identifier: GPL-2.0-only
config REGULATOR_UMP9650
 bool "U30 Pro UMP9650 regulators"
 depends on ARCH_SPRD && MFD_SC27XX_PMIC && (!SUSPEND || U30PRO_KEXEC_BASE)
config REGULATOR_UMP9651
 bool "U30 Pro UMP9651 regulators"
 depends on ARCH_SPRD && MFD_SC27XX_PMIC && (!SUSPEND || U30PRO_KEXEC_BASE)
```

## devices/u30pro/native/kernel/ums9632/overlay/drivers/unisoc_platform/Kconfig
```kconfig
config U30PRO_BSP
 bool "U30 Pro UMS9632 vendor BSP components"
 depends on ARCH_SPRD

if U30PRO_BSP
source "drivers/unisoc_platform/usb/musb/Kconfig"
source "drivers/unisoc_platform/usbpinmux/Kconfig"
config UNISOC_USB_HSPHY
 bool "UMS9632 USB2 high speed PHY"
 select USB_PHY
 depends on USB_GADGET
config U30PRO_KEXEC_BASE
 bool "U30 Pro kexec bootstrap with system sleep guarded"
 depends on KEXEC && SUSPEND
 help
   Enables the PM_SLEEP_SMP code needed for arm64 kexec while rejecting
   system sleep before device suspend. Type-C wake and cross-processor
   watchdog ownership during sleep remain unvalidated.

config U30PRO_CHARGER_LINK_DIAGNOSTIC
 bool "DIAGNOSTIC ONLY: bind master charger client without hardware operations"
 depends on I2C && U30PRO_KEXEC_BASE && !CHARGER_U30PRO_SGM41513
 help
   User-authorized test of dangling child-fwnode supplier ownership under
   strict fw_devlink. Does not access hardware or provide any regulator or
   charging function. Keep disabled for the base and final adaptation.

config UNISOC_USB_TYPEC
 bool "Unisoc Type-C support"
 depends on TYPEC && EXTCON && NVMEM
config UNISOC_USB_SC27XX_TYPEC
 bool "UMP9651 Type-C controller"
 depends on UNISOC_USB_TYPEC && MFD_SC27XX_PMIC && (!SUSPEND || U30PRO_KEXEC_BASE)
config UNISOC_BC1P2
 bool "Unisoc BC1.2 charger/data-port detection"
 depends on USB_PHY && EXTCON
source "drivers/unisoc_platform/sprd_charger/power_delivery/Kconfig"
source "drivers/unisoc_platform/modem/Kconfig"
source "drivers/unisoc_platform/trusty/Kconfig"
source "drivers/unisoc_platform/net/Kconfig"
source "drivers/unisoc_platform/aic8800/Kconfig"
source "drivers/unisoc_platform/display/Kconfig"
source "drivers/unisoc_platform/thermal_sensor/Kconfig"
source "drivers/unisoc_platform/sip/Kconfig"
source "drivers/unisoc_platform/cpufreq/Kconfig"
source "drivers/unisoc_platform/ase/Kconfig"
source "drivers/unisoc_platform/pmu/Kconfig"
source "drivers/unisoc_platform/scufreq/Kconfig"
source "drivers/unisoc_platform/hw_random/Kconfig"
endif
```

## devices/u30pro/native/kernel/ums9632/overlay/drivers/unisoc_platform/ase/Kconfig
```kconfig
config U30PRO_SPRD_ASE
 bool "Unisoc ASE (aging sensor) driver"
 depends on CPU_FREQ && ARCH_SPRD && MFD_SYSCON && NVMEM
 help
   Aging compensation for the CPU cluster voltages (see drivers/unisoc_platform/ase).  Does nothing unless u30pro_ase=1 is on the kernel
   command line; needs the apcpu cpufreq driver to act on the result.
config U30PRO_SPRD_ASE_GENERIC
 bool "Unisoc ASE glue for the PMIC core supply"
 depends on U30PRO_SPRD_ASE
```

## devices/u30pro/native/kernel/ums9632/overlay/drivers/unisoc_platform/cpufreq/Kconfig
```kconfig
config U30PRO_SPRD_CPUFREQ_V2
 tristate "Unisoc apcpu hardware DVFS cpufreq driver (sprd,cpufreq-v2)"
 depends on ARCH_SPRD && CPU_FREQ && U30PRO_SPRD_SIP
 select PM_OPP
 help
   Scales the voltage and frequency of the two CPU clusters through the hardware DVFS of the secure monitor (SIP SMC calls).  The
   driver only starts when the kernel command line contains u30pro_cpufreq=1.  ASE aging compensation (u30pro_ase=1) and the data for the
   software SCU frequency control (u30pro_scufreq=1, see U30PRO_SPRD_SCUFREQ) are optional; the debugfs table is ported read-only.
```

## devices/u30pro/native/kernel/ums9632/overlay/drivers/unisoc_platform/display/Kconfig
```kconfig
config UNISOC_QOGIRN5_BACKLIGHT
 bool "U30 Pro PWM backlight (sprd,qogirn5-backlight)"
 depends on PWM && BACKLIGHT_CLASS_DEVICE
 help
  Registers the board's PWM backlight as /sys/class/backlight/sprd_backlight
  with the stock 0..4095 brightness scale.
config UNISOC_NV3002C_PANEL
 bool "U30 Pro NV3002C 240x240 SPI panel (DRM)"
 depends on DRM && SPI && OF && GPIOLIB
 select DRM_KMS_HELPER
 select DRM_GEM_DMA_HELPER
 select DRM_MIPI_DBI
 select DRM_FBDEV_DMA_HELPER if DRM_FBDEV_EMULATION
 help
  DRM driver for the SPI display of the ZTE U30 Pro, written on top of the
  mipi-dbi helpers.  The panel description (init sequence, reset timing) is
  taken from the unmodified stock device tree (/lcds/<spi_panel_name>).
config UNISOC_TLSC_TOUCH
 bool "U30 Pro touch controller (tlsc6x / CHSC6448)"
 depends on I2C && INPUT && OF
 help
  Run-time touch reporting for the I2C touch panel (name tlsc6x_touch, 0..239 range).
```

## devices/u30pro/native/kernel/ums9632/overlay/drivers/unisoc_platform/hw_random/Kconfig
```kconfig
config U30PRO_SPRD_TRNG
 bool "Unisoc true random number generator (public crypto engine)"
 depends on ARCH_SPRD && HW_RANDOM
 help
   Registers the TRNG of the public crypto engine (sprd,sprd-trng) with the hw_random framework.  Written from the register
   description of the hardware, not copied from the vendor driver (which has its own licence).
```

## devices/u30pro/native/kernel/ums9632/overlay/drivers/unisoc_platform/modem/mailbox/Kconfig
```kconfig
#
# SPRD MAILBOX drivers
#
config UNISOC_MAILBOX
	tristate "Unisoc Mailbox"
	depends on ARCH_SPRD || COMPILE_TEST
	select MAILBOX
	help
	  Mailbox driver implementation for the Unisoc platform only. It is used
	  to send message between application processors and MCU. Say Y here if
	  you want to build the Unisoc mailbox controller driver.

	  Say M here to enable mailbox support in GKI projects, also you
	  can set Y in none-GKI projects.

config UNISOC_MAILBOX_R1
	bool "Unisoc Mailbox R1 Version"
	depends on UNISOC_MAILBOX
	help
	  This feature be opened indicate that the mailbox
	  module will use the mailbox r1 version.

	  Say Y here to use mailbox version R1. Only after the mailbox module
	  macro is opened, this macro can be used.

config UNISOC_MAILBOX_R2
	bool "Unisoc Mailbox R2 Version"
	depends on UNISOC_MAILBOX
	help
	  This feature be opened indicate that the mailbox
	  module will use the mailbox r2 version.

	  Say Y here to use mailbox version R2. Only after the mailbox module
	  macro is opened, this macro can be used.
```

## devices/u30pro/native/kernel/ums9632/overlay/drivers/unisoc_platform/modem/modem_loader/Kconfig
```kconfig
# SPDX-License-Identifier: GPL-2.0

config UNISOC_MODEM_LOADER
	tristate "UNISOC Modem Loader"
	select UNISOC_MODEM_POWER_MANAGER
	default n
	help
	  UNISOC modem loader driver. It will be used for modem poweron,
	  modem image load, modem memory dump, modem boot and modem reset.
	  Say M here to enable modem loader support in GKI projects, also you
	  can set Y in none-GKI projects.

config UNISOC_MODEM_LOADER_RAM_VMAP
	bool "Enable modem ram vmap ext in ARM"
	default n
	help
	  This option is use for modem map ram in ARM.
	  It will be used for modem vmap.
	  Say M here to enable modem loader ram vmap support in GKI projects, also you
	  can set Y in none-GKI projects.

config UNISOC_CH_SUPPORT
	tristate "UNISOC SUPPORT CH SYS"
	default n
	depends on UNISOC_MODEM_LOADER
	help
	  UNISOC modem loader driver is a common driver for modem
	  boot, but some SOC don't contain ch（CONTEXT HUB） system,
	  so config this Macro to control
	  some code whether support ch sys or not.
```

## devices/u30pro/native/kernel/ums9632/overlay/drivers/unisoc_platform/modem/power_manager/Kconfig
```kconfig
# SPDX-License-Identifier: GPL-2.0

config UNISOC_MODEM_POWER_MANAGER
	tristate "UNISOC Modem Power Manager"
	depends on PM_SLEEP
	default n
	help
	  This driver provide modem and sp driver to apply/get/release wakelock
	  when module business started.
	  Also it be user for modem power management.

	  Say M here to enable power_manager support in GKI projects, also you
	  can set Y in none-GKI projects.
```
